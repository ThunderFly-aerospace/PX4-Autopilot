## src/drivers/airborne_particles/Kconfig
```kconfig
menu "AIRBORNE_PARTICLES"
    menuconfig DRIVERS_AIRBORNE_PARTICLES_SENSIRION_AP
        bool "Common airborne particles sensors"
        default n
        select DRIVERS_SENSIRION_AP
        ---help---
            Enable default set of atmospheric quantities sensors

    rsource "*/Kconfig"
endmenu
```

## src/drivers/airborne_particles/sensirion_ap/Kconfig
```kconfig
menuconfig DRIVERS_AIRBORNE_PARTICLES_SENSIRION_AP
	bool "Sensirion SPS30 and SEN5x"
	default n
	---help---
		Enable SPS30 and SEN5x series airborne particles sensors.
```

## src/drivers/atmospheric_quantities/Kconfig
```kconfig
menu "atmospheric_quantities"
    menuconfig ATMOSPHERIC_QUANTITIES
        bool "Common atmospheric quantities"
        default n
        select DRIVERS_ATMOSPHERIC_SPS30
        ---help---
            Enable default set of atmospheric quantities sensors
    rsource "*/Kconfig"
endmenu #atmospheric_quantities
```

## src/drivers/atmospheric_quantities/sps30/Kconfig
```kconfig
menuconfig DRIVERS_ATMOSPHERIC_QUANTITIES_SPS30
	bool "SPS30 PM sensor"
	default n
	---help---
		Enable support SPS32 airbone particle sensor
```

## src/drivers/hygrometer/Kconfig
```kconfig
menu "Hygrometers"
    menuconfig COMMON_HYGROMETERS
        bool "Hygrometer sensors"
        default n
        select DRIVERS_HYGROMETER_SHT3x
        select DRIVERS_HYGROMETER_SHT4x
        ---help---
            Enable default set of hygrometer sensors
    rsource "*/Kconfig"
endmenu #Hygrometers
```

## src/drivers/hygrometer/sht4x/Kconfig
```kconfig
menuconfig DRIVERS_HYGROMETER_SHT4x
	bool "SHT4x temperature and humidity sensor"
	default n
	---help---
		Enable support SHT4x temperature/humidity sensor
```

## src/drivers/rpm/s35770/Kconfig
```kconfig
menuconfig DRIVERS_RPM_S35770
	bool "s35770"
	default n
	---help---
		Enable support for s35770
```

## src/drivers/tfesc03/Kconfig
```kconfig
menuconfig DRIVERS_TFESC03
	bool "tfesc03"
	default n
	---help---
		Enable support for TFESC03
```

## src/drivers/tfeschub/Kconfig
```kconfig
menuconfig DRIVERS_TFESCHUB
	bool "tfeschub"
	default n
	---help---
		Enable support for TFESCHUB
```

## src/drivers/tflora/Kconfig
```kconfig
menuconfig DRIVERS_TFLORA
	bool "tflora"
	default n
	---help---
		Enable support for TF-LORA device
```

## src/modules/detectors/Kconfig
```kconfig
menu "detectors"
    menuconfig COMMON_DETECTORS
        bool "detectors"
        default n
        select MODULES__DETECTORS__SPIRAL_DETECTOR
        ---help---
            Enable default set of flight detectors drivers
    rsource "*/Kconfig"
endmenu #detectors
```

## src/modules/detectors/spiral_detector/Kconfig
```kconfig
menuconfig MODULES_DETECTORS__SPIRAL_DETECTOR
	bool "spiral_detector"
	default n
	---help---
		Enable spiral detector
```

## src/modules/gps_lora_beacon/Kconfig
```kconfig
menuconfig MODULES_GPS_LORA_BEACON
	bool "gps_lora_beacon"
	default n
	---help---
		Enable support for TF-LORA beacon service app
```

## src/modules/lora_gps_vcmd/Kconfig
```kconfig
menuconfig MODULES_LORA_GPS_VCMD
	bool "lora_gps_vcmd"
	default n
	---help---
		Send GPS beacon over Lora, Recieve VehicleCommand
```

## src/modules/platform_open/Kconfig
```kconfig
menuconfig MODULES_PLATFORM_OPEN
	bool "platfor_open"
	default n
	---help---
		Open thunderfly Starting platform
```

## src/modules/tfcontrol/Kconfig
```kconfig
menuconfig MODULES_TFCONTROL
	bool "tfcontrol"
	default n
	---help---
		Enable tfcontrol app
```
